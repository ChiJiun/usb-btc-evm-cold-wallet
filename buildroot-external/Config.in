## buildroot-external/configs/usb_wallet_x86_64_defconfig
```kconfig
BR2_x86_64=y
BR2_TOOLCHAIN_BUILDROOT=y
BR2_TOOLCHAIN_BUILDROOT_GLIBC=y
BR2_KERNEL_HEADERS_AS_KERNEL=y
BR2_PACKAGE_HOST_LINUX_HEADERS_CUSTOM_6_12=y
BR2_DOWNLOAD_FORCE_CHECK_HASHES=y
BR2_REPRODUCIBLE=y
BR2_GLOBAL_PATCH_DIR="board/pc/patches"

BR2_TARGET_GENERIC_HOSTNAME="usb-cold-wallet"
BR2_TARGET_GENERIC_ISSUE="USB BTC+EVM Cold Wallet - TESTNET RESEARCH APPLIANCE"
# Use kernel devtmpfs directly. Buildroot's mdev mode forcibly enables
# CONFIG_NET during linux.mk config fixups and defeats the air-gap policy.
BR2_ROOTFS_DEVICE_CREATION_DYNAMIC_DEVTMPFS=y
BR2_TARGET_GENERIC_GETTY_PORT=""
BR2_ROOTFS_OVERLAY="$(BR2_EXTERNAL_USB_WALLET_PATH)/board/usb-wallet/rootfs-overlay"
BR2_ROOTFS_POST_BUILD_SCRIPT="$(BR2_EXTERNAL_USB_WALLET_PATH)/board/usb-wallet/post-build.sh"
BR2_ROOTFS_POST_IMAGE_SCRIPT="$(BR2_EXTERNAL_USB_WALLET_PATH)/board/usb-wallet/post-image.sh"

BR2_LINUX_KERNEL=y
BR2_LINUX_KERNEL_CUSTOM_VERSION=y
BR2_LINUX_KERNEL_CUSTOM_VERSION_VALUE="6.12.47"
BR2_LINUX_KERNEL_USE_CUSTOM_CONFIG=y
BR2_LINUX_KERNEL_CUSTOM_CONFIG_FILE="$(BR2_EXTERNAL_USB_WALLET_PATH)/board/usb-wallet/linux.config"
BR2_LINUX_KERNEL_NEEDS_HOST_OPENSSL=y
BR2_LINUX_KERNEL_NEEDS_HOST_LIBELF=y

BR2_TARGET_ROOTFS_INITRAMFS=y
# BR2_TARGET_ROOTFS_TAR is not set

BR2_PACKAGE_BUSYBOX_CONFIG_FRAGMENT_FILES="$(BR2_EXTERNAL_USB_WALLET_PATH)/board/usb-wallet/busybox.fragment"

BR2_PACKAGE_PYTHON3=y
BR2_PACKAGE_PYTHON3_DECIMAL=y
BR2_PACKAGE_PYTHON3_SSL=y
BR2_PACKAGE_PYTHON3_UNICODEDATA=y
BR2_PACKAGE_PYTHON3_ZLIB=y
BR2_PACKAGE_USB_WALLET_APP=y

BR2_TARGET_GRUB2=y
BR2_TARGET_GRUB2_X86_64_EFI=y
BR2_PACKAGE_HOST_DOSFSTOOLS=y
BR2_PACKAGE_HOST_GENIMAGE=y
BR2_PACKAGE_HOST_MTOOLS=y
```

## buildroot-external/package/usb-wallet-app/Config.in
```kconfig
config BR2_PACKAGE_USB_WALLET_APP
	bool "usb-wallet-app"
	depends on BR2_PACKAGE_PYTHON3
	help
	  Offline-only BTC testnet PSBT + EVM Sepolia signer and console UI.
	  Python wheels are fetched and hash-verified before the Buildroot build.
```
